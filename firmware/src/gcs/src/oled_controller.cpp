#include "oled_controller.h"
#include "radio_controller.h"
#include "gps_controller.h"
#include "power_manager.h"
#include "state_manager.h"
#include "commander.h"
#include "maths.h"
#include "logger.h"
#include <Wire.h>
#include <SSD1306Wire.h>

#define SIGNAL_LOST_TIMEOUT_MS 3000

static const uint8_t LOGO_XMB[] PROGMEM = {
    0x00, 0x00, 0x00, 0x00, 0x00, 0x00, 0x00, 0x00, 0x00, 0x00, 0x00, 0x00,
    0x00, 0x00, 0x00, 0x00, 0x00, 0x00, 0x00, 0x00, 0x00, 0x00, 0x00, 0x00,
    0x00, 0x00, 0x00, 0x00, 0x00, 0x00, 0x00, 0x00, 0x00, 0x00, 0x00, 0x00,
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    0x00, 0x00, 0x00, 0x00};

static char g_buffer[128];
static SSD1306Wire g_display(0x3C, OLED_SDA_PIN, OLED_SCL_PIN);
static int g_last_rx;
static unsigned long g_last_update_time;

static float _get_rssi_percentage(float rssi);
static void _draw_progress_bar(uint16_t x, uint16_t y, uint16_t width, uint16_t height, uint8_t progress);
static void _draw_battery_indicator(uint16_t x, uint16_t y, uint16_t width, uint16_t height, uint8_t percentage);

void oled_init()
{
    g_display.init();
    g_display.flipScreenVertically();
    g_display.setTextAlignment(TEXT_ALIGN_LEFT);
    g_display.setFont(ArialMT_Plain_10);
    g_display.clear();
    g_display.drawXbm(0, 0, 128, 64, LOGO_XMB);
    g_display.display();

    SERIAL_DEBUG_PRINTF("Initialized OLED!\n");
}

void oled_update()
{
    g_display.clear();

    g_display.setTextAlignment(TEXT_ALIGN_LEFT);

    if (radio_get_data().rx != g_last_rx)
    {
        g_last_update_time = millis();
    }

    g_last_rx = radio_get_data().rx;

    if (radio_get_data().rssi < 0 && millis() - g_last_update_time < SIGNAL_LOST_TIMEOUT_MS)
    {
        _draw_progress_bar(0, 2, 45, 6, (uint8_t)_get_rssi_percentage(radio_get_data().rssi));

        g_display.drawStringf(51, 0, g_buffer, "%d", radio_get_data().rssi);
    }
    else
    {
        g_display.drawStringf(0, 0, g_buffer, "NO SIGNAL");
    }

    if (state_get_current() == SystemState::GCS || state_get_current() == SystemState::ROCKET)
    {
        g_display.drawStringf(0, 13, g_buffer, "RX: %d", radio_get_data().rx);
        g_display.drawStringf(50, 13, g_buffer, "TX: %d", radio_get_data().tx);
        g_display.drawStringf(0, 26, g_buffer, "EXEC: %ds", commander_get_current_timeout_left());

        double lat = gps_get_data().latitude;
        double lon = gps_get_data().longitude;
        double targetLat = (double)radio_get_data().frame.lat / 10000000.0;
        double targetLon = (double)radio_get_data().frame.lon / 10000000.0;

        if (lat != 0 && targetLat != 0)
        {
            g_display.drawStringf(0, 27, g_buffer, "%d m", (int)calculate_geo_distance(lat, lon, targetLat, targetLon));
        }

        g_display.drawStringf(0, 42, g_buffer, "%.7f", state_get_current() == SystemState::GCS ? lat : targetLat);
        g_display.drawStringf(0, 52, g_buffer, "%.7f", state_get_current() == SystemState::GCS ? lon : targetLon);

        int batteryPercentage = state_get_current() == SystemState::GCS ? power_get_current_data().batteryPercentage : radio_get_data().frame.batteryPercentage;
        float batteryVoltage = state_get_current() == SystemState::GCS ? power_get_current_data().batteryVoltage : (float)radio_get_data().frame.batteryVoltage100 / 100.0f;

        _draw_battery_indicator(110, 41, 30, 15, (uint8_t)batteryPercentage);

        g_display.setTextAlignment(TEXT_ALIGN_RIGHT);
        g_display.drawStringf(127, 0, g_buffer, state_get_current() == SystemState::GCS ? "GCS" : "ROCKET");
        g_display.drawStringf(127, 18, g_buffer, "%d %%", batteryPercentage);
        g_display.drawStringf(127, 53, g_buffer, "%.2f V", batteryVoltage);
    }
    else if (state_get_current() == SystemState::OTHER)
    {
        g_display.setTextAlignment(TEXT_ALIGN_CENTER_BOTH);

        g_display.setFont(ArialMT_Plain_24);
        g_display.drawStringf(63, 32, g_buffer, "%d", radio_get_data().frame.velocity_kmh);

        g_display.setFont(ArialMT_Plain_10);
        g_display.drawStringf(63, 53, g_buffer, "km/h");
    }

    g_display.display();
}

float _get_rssi_percentage(float rssi)
{
    const float y_a = 0.0f, y_b = 100.0f, x_a = -130.0f, x_b = -10.0f;

    return constrain((y_b - y_a) / (x_b - x_a) * (rssi - x_a) + y_a, y_a, y_b);
}

void _draw_progress_bar(uint16_t x, uint16_t y, uint16_t width, uint16_t height, uint8_t progress)
{
    g_display.fillRect(x, y, width * (float)progress / 100.0f, height);
}

void _draw_battery_indicator(uint16_t x, uint16_t y, uint16_t width, uint16_t height, uint8_t percentage)
{
    const uint8_t MAX_STEPS_COUNT = 4;
    const uint16_t TOTAL_STEP_WIDTH = width / MAX_STEPS_COUNT;
    const uint16_t STEP_WIDTH = TOTAL_STEP_WIDTH * 0.75;
    const uint16_t STEP_HEIGHT = height * 0.75;

    g_display.drawRect(x - width / 2, y - height / 2, width, height);
    g_display.fillRect(x - width / 2 - width / 10, y - height / 4, width / 10, height / 2);

    uint8_t stepsCount = (uint8_t)ceilf(MAX_STEPS_COUNT * (float)percentage / 100);

    for (uint8_t i = 0; i < stepsCount; i++)
    {
        g_display.fillRect(x + TOTAL_STEP_WIDTH * (1 - i) + (TOTAL_STEP_WIDTH - STEP_WIDTH) / 2, y - STEP_HEIGHT / 2, STEP_WIDTH, STEP_HEIGHT);
    }
}