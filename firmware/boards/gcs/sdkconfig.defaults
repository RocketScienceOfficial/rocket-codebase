## firmware/boards/gcs/sdkconfig.defaults
```kconfig
# Enable Custom Partition Table
CONFIG_PARTITION_TABLE_CUSTOM=y
CONFIG_PARTITION_TABLE_CUSTOM_FILENAME="../../boards/gcs/partitions.csv"
CONFIG_PARTITION_TABLE_FILENAME="../../boards/gcs/partitions.csv"

# Bootloader config
CONFIG_ESPTOOLPY_FLASHSIZE_4MB=y

# Enable PSRAM
CONFIG_SPIRAM=y
CONFIG_SPIRAM_USE_MALLOC=y

# Set CPU to 240MHz instead of 160MHz
CONFIG_ESP_DEFAULT_CPU_FREQ_MHZ_240=y
CONFIG_ESP_DEFAULT_CPU_FREQ_MHZ=240

# Enable support for TaskCreateStatic and other static functions
CONFIG_FREERTOS_SUPPORT_STATIC_ALLOCATION=y

# Set the RTOS tick rate to 1000Hz (1ms per tick)
CONFIG_FREERTOS_HZ=1000

# Optimize for size to reduce flash usage
CONFIG_OPTIMIZATION_LEVEL_RELEASE=y
CONFIG_COMPILER_OPTIMIZATION_LEVEL_RELEASE=y
CONFIG_COMPILER_OPTIMIZATION_SIZE=y
CONFIG_COMPILER_OPTIMIZATION_ASSERTION_LEVEL=0
```
